## Config.in
```kconfig
menu "MyLinux"

source "$BR2_EXTERNAL_MYLINUX_PATH/package/myserver/Config.in"

endmenu
```

## configs/mylinux_x86_64_defconfig
```kconfig
# 
# MyLinux Server x86_64
# 
# ============================================================
# Architecture
# ============================================================

BR2_x86_64=y

# ============================================================
# Toolchain
# ============================================================

BR2_TOOLCHAIN_BUILDROOT=y
BR2_TOOLCHAIN_BUILDROOT_GLIBC=y
BR2_TOOLCHAIN_BUILDROOT_CXX=y
BR2_TOOLCHAIN_BUILDROOT_WCHAR=y
BR2_TOOLCHAIN_BUILDROOT_LOCALE=y

# ============================================================
# System
# ============================================================

BR2_TARGET_GENERIC_HOSTNAME="mylinux"

BR2_TARGET_GENERIC_ISSUE="Welcome to MyLinux Server\nKernel \r on \m"

BR2_TARGET_GENERIC_GETTY=y
BR2_TARGET_GENERIC_GETTY_PORT="tty1"

# Root password: root
BR2_TARGET_GENERIC_ROOT_PASSWD="root"

# Timezone
BR2_TARGET_GENERIC_TZ="Asia/Shanghai"

# ============================================================
# Init system
# ============================================================

BR2_INIT_SYSTEMD=y

# systemd needs /run
BR2_ROOTFS_DEVICE_CREATION_DYNAMIC_EUDEV=y

# ============================================================
# Kernel
# ============================================================

BR2_LINUX_KERNEL=y

BR2_LINUX_KERNEL_CUSTOM_VERSION=y
BR2_LINUX_KERNEL_CUSTOM_VERSION_VALUE="6.1.24"

BR2_LINUX_KERNEL_USE_CUSTOM_CONFIG=y

BR2_LINUX_KERNEL_CUSTOM_CONFIG_FILE="$(BR2_EXTERNAL_MYLINUX_PATH)/board/mylinux/linux.config"

BR2_LINUX_KERNEL_INSTALL_TARGET=y

BR2_LINUX_KERNEL_NEEDS_HOST_OPENSSL=y
BR2_LINUX_KERNEL_NEEDS_HOST_LIBELF=y

# Kernel headers
BR2_PACKAGE_HOST_LINUX_HEADERS_CUSTOM_6_1=y

# ============================================================
# Filesystem
# ============================================================

BR2_TARGET_ROOTFS_EXT2=y
BR2_TARGET_ROOTFS_EXT2_4=y
BR2_TARGET_ROOTFS_EXT2_SIZE="8G"

BR2_TARGET_ROOTFS_TAR=y

# ============================================================
# Bootloader
# ============================================================

BR2_TARGET_GRUB2=y
BR2_TARGET_GRUB2_INSTALL_TOOLS=y

# ============================================================
# Disk image
# ============================================================

BR2_PACKAGE_HOST_GENIMAGE=y

# ============================================================
# Basic GNU/Linux userspace
# ============================================================

BR2_PACKAGE_BUSYBOX=y

BR2_PACKAGE_BASH=y

BR2_PACKAGE_COREUTILS=y

BR2_PACKAGE_UTIL_LINUX=y

BR2_PACKAGE_PROCPS_NG=y

BR2_PACKAGE_KMOD=y

# ============================================================
# Filesystem tools
# ============================================================

BR2_PACKAGE_E2FSPROGS=y

# ============================================================
# Networking
# ============================================================

BR2_PACKAGE_IPROUTE2=y

BR2_PACKAGE_IPUTILS=y

BR2_PACKAGE_ETHTOOL=y

BR2_PACKAGE_BIND=y

BR2_PACKAGE_CA_CERTIFICATES=y

# ============================================================
# DHCP
# ============================================================

BR2_SYSTEM_DHCP="eth0"

# ============================================================
# SSH
# ============================================================

BR2_PACKAGE_OPENSSH=y

# ============================================================
# Editors / utilities
# ============================================================

BR2_PACKAGE_VIM=y

BR2_PACKAGE_LESS=y

BR2_PACKAGE_FILE=y

BR2_PACKAGE_TAR=y

BR2_PACKAGE_GZIP=y

BR2_PACKAGE_XZ=y

# ============================================================
# Git
# ============================================================

BR2_PACKAGE_GIT=y

# ============================================================
# Python
# ============================================================

BR2_PACKAGE_PYTHON3=y

# ============================================================
# Root filesystem overlay
# ============================================================

BR2_ROOTFS_OVERLAY="$(BR2_EXTERNAL_MYLINUX_PATH)/board/mylinux/rootfs-overlay"

# ============================================================
# Post build
# ============================================================

# BR2_ROOTFS_POST_BUILD_SCRIPT="$(BR2_EXTERNAL_MYLINUX_PATH)/board/mylinux/post-build.sh"
BR2_ROOTFS_POST_BUILD_SCRIPT="$(BR2_EXTERNAL_MYLINUX_PATH)/board/mylinux/post-build.sh board/pc/post-build.sh"
# ============================================================
# Post image
# ============================================================

BR2_ROOTFS_POST_IMAGE_SCRIPT="support/scripts/genimage.sh"
BR2_ROOTFS_POST_SCRIPT_ARGS="-c $(BR2_EXTERNAL_MYLINUX_PATH)/board/mylinux/genimage-bios.cfg"
```

## package/myserver/Config.in
```kconfig
config BR2_PACKAGE_MYSERVER
	bool "myserver"
	help
	  MyLinux example server application.

	  A simple custom server used to verify
	  the MyLinux Buildroot package system.
```
